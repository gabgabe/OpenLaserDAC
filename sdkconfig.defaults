## sdkconfig.defaults
```kconfig
# ESP-IDF Configuration for OpenLaserDAC
# Optimized for realtime laser DAC output

# Target ESP32-S3
CONFIG_IDF_TARGET="esp32s3"

# CPU Settings
CONFIG_ESP_DEFAULT_CPU_FREQ_MHZ_240=y
CONFIG_ESP_SYSTEM_EVENT_QUEUE_SIZE=32
CONFIG_ESP_MAIN_TASK_STACK_SIZE=4096
CONFIG_ESP_MAIN_TASK_AFFINITY_CPU0=y

# FreeRTOS Settings
CONFIG_FREERTOS_HZ=1000
CONFIG_FREERTOS_UNICORE=n
CONFIG_FREERTOS_TIMER_TASK_STACK_DEPTH=3072
CONFIG_FREERTOS_CHECK_STACKOVERFLOW_CANARY=y

# Memory
CONFIG_SPIRAM=n
CONFIG_ESP32S3_INSTRUCTION_CACHE_32KB=y
CONFIG_ESP32S3_DATA_CACHE_64KB=y

# Flash Settings
CONFIG_ESPTOOLPY_FLASHSIZE_4MB=y
CONFIG_ESPTOOLPY_FLASHMODE_QIO=y
CONFIG_ESPTOOLPY_FLASHFREQ_80M=y
CONFIG_PARTITION_TABLE_CUSTOM=y
CONFIG_PARTITION_TABLE_CUSTOM_FILENAME="partitions.csv"

# WiFi
CONFIG_ESP_WIFI_STATIC_RX_BUFFER_NUM=16
CONFIG_ESP_WIFI_DYNAMIC_RX_BUFFER_NUM=64
CONFIG_ESP_WIFI_TX_BUFFER_TYPE=1
CONFIG_ESP_WIFI_STATIC_TX_BUFFER_NUM=16
CONFIG_ESP_WIFI_AMPDU_RX_ENABLED=y
CONFIG_ESP_WIFI_AMPDU_TX_ENABLED=y
CONFIG_ESP_WIFI_NVS_ENABLED=y
CONFIG_ESP_WIFI_SOFTAP_SUPPORT=y
CONFIG_ESP_WIFI_STA_DISCONNECTED_PM_ENABLE=n
CONFIG_ESP_WIFI_EXTRA_IRAM_OPT=y

# LWIP
CONFIG_LWIP_LOCAL_HOSTNAME="OpenLaserDAC"
CONFIG_LWIP_MAX_SOCKETS=12
CONFIG_LWIP_SO_REUSE=y
CONFIG_LWIP_SO_RCVBUF=y
CONFIG_LWIP_TCP_SND_BUF_DEFAULT=32768
# TCP window: limit to 14 KB so the sender never has more than ~10 TCP segments
# in flight.  The W5500 MACRAW RX buffer is 16 KB; at MSS=1440, 11 segments
# produce ~16.4 KB of Ethernet frames which overflows the chip.  14 KB keeps
# the burst under 10 segments (~14.9 KB) with comfortable margin.
CONFIG_LWIP_TCP_WND_DEFAULT=14336
CONFIG_LWIP_TCP_RECVMBOX_SIZE=64
CONFIG_LWIP_UDP_RECVMBOX_SIZE=32

# LWIP performance: hot-path functions in IRAM (saves ~10-20% recv latency)
CONFIG_LWIP_IRAM_OPTIMIZATION=y

# Bypass VFS layer for select() — we only use sockets, no file descriptors
CONFIG_LWIP_USE_ONLY_LWIP_SELECT=y

# Pin LWIP tcpip_task to Core 0 (keep Core 1 clean for DAC ISR + refill)
CONFIG_LWIP_TCPIP_TASK_AFFINITY_CPU0=y

# LWIP priority MUST be higher than network_task (19) to avoid priority inversion:
# tcpip_task must process TCP segments before network_task can recv() them.
# Default was 18 — network_task (19) would preempt it, causing up to 1ms stalls.
CONFIG_LWIP_TCPIP_TASK_PRIO=20

# TCP timer optimization (safe - no memory impact)
CONFIG_LWIP_TCP_TMR_INTERVAL=100
CONFIG_LWIP_TCP_RTO_TIME=300

# Reduce TIME_WAIT duration: default TCP_MSL=60000 → TIME_WAIT=120 seconds.
# During disconnect/reconnect storms Liberation opens 10+ connections in 5s,
# each one sits in TIME_WAIT exhausting the 16-PCB pool.
# With SO_LINGER(0) we send RST instead of FIN, but as a safety net reduce
# MSL to 1s (TIME_WAIT = 2s) and FIN_WAIT to 2s.
CONFIG_LWIP_TCP_MSL=1000
CONFIG_LWIP_TCP_FIN_WAIT_TIMEOUT=2000

# Ethernet (W5500 via SPI)
CONFIG_ETH_USE_SPI_ETHERNET=y
CONFIG_ETH_SPI_ETHERNET_W5500=y

# SPI
CONFIG_SPI_MASTER_IN_IRAM=y
CONFIG_SPI_SLAVE_ISR_IN_IRAM=y

# GPIO
CONFIG_GPIO_CTRL_FUNC_IN_IRAM=y

# Timer
CONFIG_GPTIMER_ISR_IRAM_SAFE=y
CONFIG_GPTIMER_CTRL_FUNC_IN_IRAM=y

# HTTP Server
CONFIG_HTTPD_MAX_REQ_HDR_LEN=1024
CONFIG_HTTPD_MAX_URI_LEN=512
CONFIG_HTTPD_QUEUE_WORK_BLOCKING_TIMEOUT=500

# Logging
CONFIG_LOG_DEFAULT_LEVEL_INFO=y
CONFIG_LOG_MAXIMUM_LEVEL_DEBUG=y

# Watchdog
CONFIG_ESP_TASK_WDT_TIMEOUT_S=10
CONFIG_ESP_TASK_WDT_CHECK_IDLE_TASK_CPU0=y
CONFIG_ESP_TASK_WDT_CHECK_IDLE_TASK_CPU1=n

# Compiler Optimizations
CONFIG_COMPILER_OPTIMIZATION_PERF=y
CONFIG_COMPILER_OPTIMIZATION_ASSERTIONS_DISABLE=n
CONFIG_COMPILER_STACK_CHECK_MODE_NORM=y
```
